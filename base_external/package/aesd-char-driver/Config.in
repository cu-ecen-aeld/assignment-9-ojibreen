## base_external/package/aesd-char-driver/Config.in
```kconfig
config BR2_PACKAGE_AESD_CHAR_DRIVER
	bool "AESD_CHAR_DRIVER"
	help
	  Includes AESD Char Driver in the installation
```

## base_external/package/ldd/Config.in
```kconfig
config BR2_PACKAGE_LDD
	bool "LDD"
	help
	  Loads device drivers from AESD LDD repository.
	  Used to understand Linux drivers and buildroot packages.
```
